/dts-v1/;
/plugin/;


/{

		fragment@0 	{
			target-path = "/";
			  __overlay__ {
					guinnux {
							description = "Raspberry Pi One";
							net {
					            wan  = "eth0";
						    };
					};
			};
		};
};