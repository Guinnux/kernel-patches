/dts-v1/;
/plugin/;


/{

		fragment@0 	{
			target-path = "/";
			  __overlay__ {
					guinnux {
							description = "Raspberry Pi 3";
							net {
					            wan  = "eth0";
						    };
					};
			};
		};
};